## configs/tcl/tflip6_defconfig
```kconfig
CONFIG_BOOTLOADER_BASE=0x46000000
CONFIG_BOOTLOADER_SIZE=0x91420
CONFIG_BOOTMODE_ADDRESS=0x460940f4
CONFIG_APP_CALLER=0x4601beb2
CONFIG_APP_ADDRESS=0x4602c3cc
CONFIG_DPRINTF_ADDRESS=0x4602BD10
CONFIG_FASTBOOT_FAIL_ADDRESS=0x4601F64C
CONFIG_FASTBOOT_INFO_ADDRESS=0x4601F5CC
CONFIG_FASTBOOT_OKAY_ADDRESS=0x4601F818
CONFIG_FASTBOOT_PUBLISH_ADDRESS=0x4601F258
CONFIG_FASTBOOT_REGISTER_ADDRESS=0x4601F21C
CONFIG_FREE_ADDRESS=0x4602C140
CONFIG_LK_LOG_STORE_ADDRESS=0x4603AAA0
CONFIG_MALLOC_ADDRESS=0x4601556C
CONFIG_PARTITION_READ_ADDRESS=0x4604230C
CONFIG_PLATFORM_INIT_ADDRESS=0x4600243C
CONFIG_PLATFORM_INIT_CALLER=0x4601a7e4
CONFIG_THREAD_CREATE_ADDRESS=0x4601AFA0
CONFIG_THREAD_RESUME_ADDRESS=0x4601B1B4
CONFIG_TCL_TFLIP6=y
CONFIG_MEDIATEK_MT6739=y
CONFIG_MTK_DETECT_KEY_ADDRESS=0x46004214
CONFIG_VIDEO_PRINTF_ADDRESS=0x46002220
```
